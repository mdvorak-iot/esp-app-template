## main/Kconfig.projbuild
```kconfig
menu "Application config"
    config APP_DEVICE_NAME
        string "Device name"
        default "app_template"
        help
            Default name of the device, used in provisioning and as a hostname.

    config APP_CONTROL_BUTTON_PIN
        int "Control button PIN"
        default 0
        help
            GPIO pin for the control button.

    config APP_CONTROL_BUTTON_PROVISION_MS
        int "Control button provisioning delay in ms"
        default 3000

    config APP_CONTROL_BUTTON_FACTORY_RESET_MS
        int "Control button factory reset delay in ms"
        default 10000

    config APP_SNTP_SERVER
        string "SNTP server"
        default "pool.ntp.org"
endmenu
```

## sdkconfig.defaults
```kconfig
# Custom partition table
CONFIG_ESPTOOLPY_FLASHSIZE_4MB=y

# Enable support for power management
CONFIG_PM_ENABLE=y
CONFIG_PM_DFS_INIT_AUTO=y
CONFIG_FREERTOS_USE_TICKLESS_IDLE=y

# Disable insecure TLS
CONFIG_MBEDTLS_SSL_PROTO_TLS1=n
CONFIG_MBEDTLS_SSL_PROTO_TLS1_1=n

# Wi-Fi provisioning
CONFIG_WIFI_AUTO_PROV_TYPE_BLE=y
CONFIG_WIFI_AUTO_PROV_TYPE_SOFT_AP=n

# BLE for provisioning
CONFIG_BT_ENABLED=y
CONFIG_BTDM_CTRL_MODE_BLE_ONLY=y
CONFIG_BTDM_CTRL_MODE_BR_EDR_ONLY=n
CONFIG_BTDM_CTRL_MODE_BTDM=n
CONFIG_BT_NIMBLE_ENABLED=y

# Status LED
CONFIG_STATUS_LED_DEFAULT_ENABLE=y
CONFIG_STATUS_LED_DEFAULT_GPIO=5
CONFIG_STATUS_LED_DEFAULT_ON=1
```
